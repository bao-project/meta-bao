## conf/layer.conf
```bitbake
# We have a conf and classes directory, add to BBPATH
BBPATH .= ":${LAYERDIR}"

# We have recipes-* directories, add to BBFILES
BBFILES += "${LAYERDIR}/recipes-*/*/*.bb \
            ${LAYERDIR}/recipes-*/*/*.bbappend"

BBFILE_COLLECTIONS += "bao"
BBFILE_PATTERN_bao = "^${LAYERDIR}/"
BBFILE_PRIORITY_bao = "6"

LAYERDEPENDS_bao = "meta-toradex-torizon"
LAYERSERIES_COMPAT_bao = "scarthgap"
```
